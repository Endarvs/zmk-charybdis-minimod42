## boards/shields/charybdis/Kconfig.defconfig
```kconfig
# Copyright (c) 2026 The ZMK Contributors
# SPDX-License-Identifier: MIT

if SHIELD_CHARYBDIS_RIGHT

config ZMK_KEYBOARD_NAME
    default "V&Z-MINI36M"

config ZMK_SPLIT_ROLE_CENTRAL
    default y

config ZMK_SPLIT_BLE_CENTRAL_PERIPHERALS
    default 1

config BT_MAX_CONN
    default 6

config BT_MAX_PAIRED
    default 6

endif # SHIELD_CHARYBDIS_RIGHT

if SHIELD_CHARYBDIS_DONGLE

config ZMK_KEYBOARD_NAME
    default "V&Z-MINI36M"

config ZMK_SPLIT_ROLE_CENTRAL
    default y

config ZMK_SPLIT_BLE_CENTRAL_PERIPHERALS
    default 2

config BT_MAX_CONN
    default 7

config BT_MAX_PAIRED
    default 7

endif # SHIELD_CHARYBDIS_DONGLE

if SHIELD_CHARYBDIS_LEFT || SHIELD_CHARYBDIS_RIGHT_DONGLE

config BT_MAX_CONN
    default 1

config BT_MAX_PAIRED
    default 1

endif # Peripherals

if SHIELD_CHARYBDIS_LEFT || SHIELD_CHARYBDIS_RIGHT || SHIELD_CHARYBDIS_RIGHT_DONGLE || SHIELD_CHARYBDIS_DONGLE

config ZMK_SPLIT
    default y

endif
```

## boards/shields/charybdis/Kconfig.shield
```kconfig
# Copyright (c) 2026 The ZMK Contributors
# SPDX-License-Identifier: MIT

# No whitespace after commas!
config SHIELD_CHARYBDIS_LEFT
    def_bool $(shields_list_contains,charybdis_left)

config SHIELD_CHARYBDIS_RIGHT
    def_bool $(shields_list_contains,charybdis_right)

config SHIELD_CHARYBDIS_RIGHT_DONGLE
    def_bool $(shields_list_contains,charybdis_right_dongle)

config SHIELD_CHARYBDIS_DONGLE
    def_bool $(shields_list_contains,charybdis_dongle)
```
