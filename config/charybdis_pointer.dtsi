/*
 * Конвейер обработки трекбола Charybdis Mini MOD (Live Runtime ZMK Processor)
 * Подключается автоматически на центральной стороне (charybdis_right или charybdis_dongle).
 *
 * Все режимы и коэффициенты управляются НА ЛЕТУ из приложения Charybdis Helper (порт MI_02)
 * с энергонезависимым сохранением в NVS Flash микроконтроллера:
 *   - Слой 6 (L_MOUSE):        Auto-Mouse с защитой от вибраций (350 мс + порог 5 пикселей) и защитой перетаскивания
 *   - Слой 7 (L_SNIPE):        Снайперское замедление (1:2 / 1:3 / 1:4) с субпиксельным остатком
 *   - Слой 8 (L_SCROLL):       Плавный 2D-скролл (регулируемая скорость + инверсия Natural Scroll)
 *   - Слой 9 (L_MANUAL_MOUSE): Ручной режим (курсор активен всегда, кнопки мыши только по Nav + ~)
 *   - Слой 10 (L_MUTE_TB):     Полная аппаратная блокировка трекбола (Trackball Mute)
 *
 * Полностью изолировано внутри прошивки клавиатуры — глобальные настройки мыши Windows НЕ затрагиваются!
 */

#include <input/processors.dtsi>
#include <dt-bindings/zmk/input_transform.h>

/ {
    pointer_accel: pointer_accel {
        compatible = "zmk,input-processor-acceleration";
        status = "okay";
        #input-processor-cells = <0>;
        input-type = <INPUT_EV_REL>;
        track-remainders;
        min-factor = <460>;
        max-factor = <5800>;
        speed-threshold = <600>;
        speed-max = <3200>;
        acceleration-exponent = <2>;
    };
};

&trackball_listener {
    input-processors = <&pointer_accel>;
};
